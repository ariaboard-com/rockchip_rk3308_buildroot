## package/fonts-noto-cjk/Config.in
```kconfig
config BR2_PACKAGE_FONTS_NOTO_CJK
	bool "\"No Tofu\" font families with large Unicode coverage (CJK)"
	help
	  Noto is a collection of font families, each visually harmonized across scripts.
	
	  This package contains Noto font families for Traditional Chinese, Simplified Chinese, Japanese and Korean:

	   * Noto Sans CJK JP
	   * Noto Sans CJK KR
	   * Noto Sans CJK SC
	   * Noto Sans CJK TC
	   * Noto Sans Mono CJK JP
	   * Noto Sans Mono CJK KR
	   * Noto Sans Mono CJK SC
	   * Noto Sans Mono CJK TC
	
	  These fonts are derived from the font family Source Han Sans.
	
	  The name "Noto" is short for "No Tofu", describing the aim of covering all living Unicode scripts.
	
	  Tofu (豆腐) is Japanese jargon for unicode replacement character "�" (U+FFFD) often displayed as replacement for unassigned or unknown characters. 
```

## package/liblunaheartbeat/Config.in
```kconfig
config BR2_PACKAGE_LIBLUNAHEARTBEAT
	bool "liblunaheartbeat"
	select BR2_PACKAGE_LIBGLIB2
	help
	  Luna Heartbeat Library for Luna/Pudge project.
	  https://git.g77k.com

comment "liblunaheartbeat needs a toolchain w/ C++, threads"
```

## package/pudge-ntdriver-box-lf/Config.in
```kconfig
config BR2_PACKAGE_PUDGE_NTDRIVER_BOX_LF
	bool "Pudge NTDriver Box GUI (Low Floor Version)"
	select BR2_PACKAGE_LIBPUDGE
	select BR2_PACKAGE_QT5BASE
	select BR2_PACKAGE_QT5BASE_GUI
	select BR2_PACKAGE_PYTHON3
	select BR2_PACKAGE_PYTHON_PYQT5
	help
          GUI for Pudge Driver Box (Low Floor Version) .
          https://git.g77k.com
```

## package/pudge-ntdriver-box/Config.in
```kconfig
config BR2_PACKAGE_PUDGE_NTDRIVER_BOX
	bool "Pudge NTDriver Box GUI"
	select BR2_PACKAGE_LIBPUDGE
	select BR2_PACKAGE_QT5BASE
	select BR2_PACKAGE_QT5BASE_GUI
	help
          GUI for pudge ntdriver box.
          https://git.g77k.com
```

## package/pudge-server/Config.in
```kconfig
config BR2_PACKAGE_PUDGE_SERVER
	bool "pudge-server"
	select BR2_PACKAGE_LIBPUDGE
	select BR2_PACKAGE_LIBLUNAHEARTBEAT
	select BR2_PACKAGE_UTIL_LINUX_LIBUUID
	select BR2_PACKAGE_JSON_C
	help
	  Luna Pudge Server for driver unicast & broadcast.
	  https://git.g77k.com
```

## package/python-asclepius/Config.in
```kconfig
config BR2_PACKAGE_PYTHON_ASCLEPIUS
	bool "python-asclepius"
	help
	  Asclepius backend library on Python 3.
```

## package/wqy-zenhei/Config.in
```kconfig
config BR2_PACKAGE_WQY_ZENHEI
	bool "Wenquanyi Zenhei"
	help
	  The DejaVu fonts are a font family based on the Vera Fonts.
	  Its purpose is to provide a wider range of characters while
	  maintaining the original look and feel through the process
	  of collaborative development, under a Free license.

	  http://dejavu-fonts.org

	  WenQuanYi Zen Hei is a Hei-Ti style (sans-serif type) Chinese font.
	  It was designed for general purpose text formatting and on-screen
	  display of Chinese characters among many other languages. The embolden
	  strokes of the font glyphs produces enhanced screen contrast, making
	  it easier to read and recognize. The embedded bitmap glyphs further
	  enhance on-screen performance, and can be enabled with the provided
	  configuration files.

	  WenQuanYi Zen Hei provides a fairly complete coverage of Chinese
	  Hanzi glyphs, including both simplified and traditional forms.
	  The total glyph number in this font is over 35,000, including over
	  21,000 Chinese Hanzi. This font provides full coverage of GBK (CP936)
	  charset, CJK Unified Ideographs, as well as the code-points needed
	  for zh_CN, zh_SG, zh_TW, zh_HK, zh_MO, ja (Japanese) and ko (Korean)
	  locales for fontconfig.

	  Starting from version 0.8, this font package provides two font families,
	  i.e. the proportional "WenQuanYi Zen Hei", and the monospaced typeface
	  named "WenQuanYi Zen Hei Mono".
```
